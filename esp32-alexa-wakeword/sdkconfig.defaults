## esp32-alexa-wakeword/sdkconfig.defaults
```kconfig
# ESP32-S3 Alexa Wake Word - Default SDK Configuration

# Target Configuration
CONFIG_IDF_TARGET="esp32s3"

# Serial flasher config
CONFIG_ESPTOOLPY_FLASHSIZE_4MB=y
CONFIG_ESPTOOLPY_FLASHSIZE="4MB"

# Partition Table
CONFIG_PARTITION_TABLE_SINGLE_APP=y

# Compiler options
CONFIG_COMPILER_OPTIMIZATION_SIZE=y

# FreeRTOS
CONFIG_FREERTOS_HZ=1000
CONFIG_FREERTOS_UNICORE=n

# ESP System Settings
CONFIG_ESP_SYSTEM_EVENT_TASK_STACK_SIZE=4096
CONFIG_ESP_MAIN_TASK_STACK_SIZE=8192

# Log output
CONFIG_LOG_DEFAULT_LEVEL_INFO=y
CONFIG_LOG_MAXIMUM_LEVEL_VERBOSE=y

# I2S Configuration
CONFIG_I2S_ENABLE_DEBUG_LOG=n

# ESP-SR Configuration (uncomment when ESP-SR is added)
# CONFIG_SR_MODEL_WN9_QUANT=y
# CONFIG_SR_WN9_QUANT_ALEXA=y

# Memory
CONFIG_ESP_DEFAULT_CPU_FREQ_MHZ_240=y
CONFIG_SPIRAM=y
CONFIG_SPIRAM_MODE_OCT=y
CONFIG_SPIRAM_SPEED_80M=y

# Bootloader
CONFIG_BOOTLOADER_LOG_LEVEL_INFO=y
```
